## CMakeLists.txt
```
# IOTCONNECT UART telemetry-source demo.
#
# For connectivity-less MCUs (no Ethernet/Wi-Fi/IP transport in their Zephyr
# port): compiles the portable iotc-c-lib protocol core + cJSON directly into the
# app and emits IOTCONNECT 2.1 telemetry JSON over the console UART every few
# seconds. A gateway relays that JSON to the cloud (over CAN FD / UART, or a
# future cell-modem bearer). Unlike the other demos, this one does NOT pull in
# the iotc-zephyr-sdk module (no net/TLS/MQTT stack) -- it needs only iotc-c-lib.
cmake_minimum_required(VERSION 3.20.0)
find_package(Zephyr REQUIRED HINTS $ENV{ZEPHYR_BASE})
project(iotc_uart_telemetry_source)

# Locate iotc-c-lib: -DZEPHYR_IOTC_C_LIB_MODULE_DIR=..., then the environment
# variable of the same name, then the conventional west workspace path.
set(IOTC_C_LIB_DIR ${ZEPHYR_IOTC_C_LIB_MODULE_DIR})
if(NOT IOTC_C_LIB_DIR)
  set(IOTC_C_LIB_DIR $ENV{ZEPHYR_IOTC_C_LIB_MODULE_DIR})
endif()
if(NOT IOTC_C_LIB_DIR)
  set(IOTC_C_LIB_DIR ${ZEPHYR_BASE}/../modules/lib/iotc-c-lib)
endif()
if(NOT EXISTS ${IOTC_C_LIB_DIR}/core/src/iotcl.c)
  message(FATAL_ERROR
    "iotc-c-lib not found at '${IOTC_C_LIB_DIR}'.\n"
    "Pass -DZEPHYR_IOTC_C_LIB_MODULE_DIR=<path-to-iotc-c-lib> "
    "or set the environment variable of the same name.")
endif()

target_sources(app PRIVATE
  src/main.c
  ${IOTC_C_LIB_DIR}/core/src/iotcl.c
  ${IOTC_C_LIB_DIR}/core/src/iotcl_c2d.c
  ${IOTC_C_LIB_DIR}/core/src/iotcl_internal.c
  ${IOTC_C_LIB_DIR}/core/src/iotcl_telemetry.c
  ${IOTC_C_LIB_DIR}/core/src/iotcl_util.c
  ${IOTC_C_LIB_DIR}/lib/cJSON/cJSON.c
)

target_include_directories(app PRIVATE
  ${IOTC_C_LIB_DIR}/core/include
  ${IOTC_C_LIB_DIR}/lib/cJSON
)

# Optional: pull in the SDK's device-vitals module so the emitted JSON also
# carries a "sys" object (CPU/heap/die-temp/uptime/reset). It only needs
# iotc-c-lib + Zephyr (no network stack), so it links into this SDK-free demo.
# Located like iotc-c-lib: -DZEPHYR_IOTC_SDK_MODULE_DIR, env, then workspace path.
set(IOTC_SDK_DIR ${ZEPHYR_IOTC_SDK_MODULE_DIR})
if(NOT IOTC_SDK_DIR)
  set(IOTC_SDK_DIR $ENV{ZEPHYR_IOTC_SDK_MODULE_DIR})
endif()
if(NOT IOTC_SDK_DIR)
  set(IOTC_SDK_DIR ${IOTC_C_LIB_DIR}/../iotc-zephyr-sdk)
endif()
if(EXISTS ${IOTC_SDK_DIR}/lib/zephyr-layer/iotc_device_vitals.c)
  target_sources(app PRIVATE ${IOTC_SDK_DIR}/lib/zephyr-layer/iotc_device_vitals.c)
  target_include_directories(app PRIVATE ${IOTC_SDK_DIR}/include)
  target_compile_definitions(app PRIVATE HAVE_IOTC_VITALS)
  message(STATUS "uart-telemetry-source: device vitals enabled from ${IOTC_SDK_DIR}")
else()
  message(STATUS "uart-telemetry-source: iotc-zephyr-sdk not found; 'sys' vitals omitted")
endif()
```

## sample.yaml
```
sample:
  name: IOTCONNECT UART telemetry source
  description: >
    Build IOTCONNECT 2.1 telemetry JSON on-device with the portable iotc-c-lib
    core and emit it over the console UART for a gateway to forward. For
    connectivity-less MCUs with no Ethernet/Wi-Fi/IP transport.
tests:
  sample.iotconnect.uart_telemetry_source:
    harness: console
    platform_allow:
      - frdm_mcxe31b
      - frdm_mcxw72
    harness_config:
      type: one_line
      regex:
        - "IOTC-TELEMETRY: .*"
    tags:
      - iotconnect
```

## prj.conf
```kconfig
# IOTCONNECT UART telemetry-source -- common config (board-agnostic).
# Board-specific overrides, if any, live in boards/<board>.conf.

# Console output
CONFIG_PRINTK=y
CONFIG_LOG=y

# iotc-c-lib + cJSON allocate dynamically (routed to k_malloc/k_free).
CONFIG_HEAP_MEM_POOL_SIZE=32768

# cJSON serializes doubles via libc sprintf("%g") -> needs an FP-capable libc.
# Picolibc needs float printf explicitly enabled, else doubles print as "*float*".
CONFIG_PICOLIBC=y
CONFIG_PICOLIBC_IO_FLOAT=y

CONFIG_MAIN_STACK_SIZE=8192

# --- Device vitals sidecar (compiled only if the SDK is on the module path) ---
# Backs sys.cpu_pct (thread usage), sys.heap_* (heap stats), and sys.reset_cause
# (hwinfo). sys.temp_c (on-chip die temperature) needs a board-specific,
# calibrated ADC overlay (reference-manual dependent), so it is omitted for now.
CONFIG_SCHED_THREAD_USAGE=y
CONFIG_THREAD_RUNTIME_STATS=y
CONFIG_SYS_HEAP_RUNTIME_STATS=y
CONFIG_HWINFO=y
```

## boards/frdm_mcxe31b.conf
```kconfig
# FRDM-MCXE31B (NXP MCXE31B, Cortex-M7 @160 MHz) -- constrained/safety MCU.
#   Console: LPUART5 @115200 over the onboard MCU-Link VCom.
#   No Ethernet/Wi-Fi/IP stack in this Zephyr port -> UART telemetry source.
# No board-specific overrides are needed; the common prj.conf covers this target.
# (This file is the extension point if a board-specific tweak is ever required.)
```

## boards/frdm_mcxw72.conf
```kconfig
# FRDM-MCXW72 (NXP MCXW727C, Cortex-M33) -- 802.15.4 (Thread) radio only, no
# Ethernet/Wi-Fi.
#   Console: lpuart1 @115200 over the onboard J-Link OB VCom.
#   No IP stack in this build -> UART telemetry source (a direct-IP path is
#   planned via a cell-modem Click bearer).
# No board-specific overrides are needed; the common prj.conf covers this target.
```

## src/main.c
```c
/*
 * Copyright (c) 2026 Avnet, Inc.
 * SPDX-License-Identifier: MIT
 *
 * IOTCONNECT UART telemetry source -- for connectivity-less MCUs.
 *
 * Proves the portable Avnet /IOTCONNECT protocol core (iotc-c-lib) runs on
 * silicon whose Zephyr port has NO IP driver (no Ethernet/Wi-Fi, so no MQTT/TLS):
 * every few seconds it builds an IOTCONNECT 2.1 telemetry message with the
 * iotcl_telemetry_* API, serializes it to JSON, and prints it on the console
 * UART. The emitted "IOTC-TELEMETRY: {...}" line is meant to be relayed by a
 * gateway (over CAN FD / UART, or a future cell-modem Click bearer) to an
 * IP-capable node running the full iotc-zephyr-sdk.
 *
 * This is the "telemetry source" pattern that lets a connectivity-less
 * safety/industrial or wireless-only MCU contribute to IOTCONNECT today.
 * The board name is taken from CONFIG_BOARD, so one app serves every target;
 * add a board by dropping a boards/<board>.conf in this demo.
 *
 * Verified on FRDM-MCXE31B (Cortex-M7) and FRDM-MCXW72 (Cortex-M33, 802.15.4).
 */

#include <zephyr/kernel.h>
#include <zephyr/sys/printk.h>

#include "iotcl.h"
#include "iotcl_telemetry.h"
#ifdef HAVE_IOTC_VITALS
#include "iotconnect_vitals.h"
#endif

#define TELEMETRY_PERIOD_S 5

static int iotc_setup(void)
{
	/* Route iotc-c-lib (and cJSON) allocations onto the Zephyr heap. MUST be
	 * called before any other library call. */
	iotcl_configure_dynamic_memory(k_malloc, k_free);

	IotclClientConfig cfg;

	iotcl_init_client_config(&cfg);
	cfg.device.instance_type = IOTCL_DCT_CUSTOM; /* building JSON, not connecting */
	cfg.device.cpid = "DEMO-CPID";
	cfg.device.duid = CONFIG_BOARD "-01";
	cfg.mqtt_send_cb = NULL; /* serialize directly instead of publishing */
	cfg.time_fn = NULL;      /* let the server timestamp on arrival */

	return iotcl_init(&cfg);
}

int main(void)
{
	printk("\n=== IOTCONNECT UART telemetry source -- %s ===\n", CONFIG_BOARD);
	printk("Building IOTCONNECT 2.1 telemetry JSON on-device via iotc-c-lib.\n");
	printk("No IP transport in this build -> output to UART for a gateway to "
	       "forward.\n\n");

	int ret = iotc_setup();

	if (ret != 0) {
		printk("iotcl_init failed: %d\n", ret);
		return 0;
	}

	uint32_t seq = 0;

	while (1) {
		IotclMessageHandle msg = iotcl_telemetry_create();

		if (msg == NULL) {
			printk("telemetry_create failed (out of memory)\n");
			k_sleep(K_SECONDS(TELEMETRY_PERIOD_S));
			continue;
		}

		/* A representative payload for a constrained edge node. */
		int64_t uptime_ms = k_uptime_get();
		double  pseudo_temp = 30.0 + (double)((uptime_ms / 1000) % 100) / 10.0;

		iotcl_telemetry_set_number(msg, "sequence", (double)seq++);
		iotcl_telemetry_set_number(msg, "uptime_s", (double)uptime_ms / 1000.0);
		iotcl_telemetry_set_number(msg, "cpu_temp_c", pseudo_temp);
		iotcl_telemetry_set_string(msg, "board", CONFIG_BOARD);
		iotcl_telemetry_set_string(msg, "bearer", "uart-source");
		iotcl_telemetry_set_string(msg, "status", "Ready");
		iotcl_telemetry_set_bool(msg, "safe_state", true);
#ifdef HAVE_IOTC_VITALS
		iotc_vitals_append(msg);
#endif

		char *json = iotcl_telemetry_create_serialized_string(msg, false);

		if (json != NULL) {
			printk("IOTC-TELEMETRY: %s\n", json);
			iotcl_telemetry_destroy_serialized_string(json);
		} else {
			printk("telemetry serialize failed\n");
		}

		iotcl_telemetry_destroy(msg);
		k_sleep(K_SECONDS(TELEMETRY_PERIOD_S));
	}

	return 0;
}
```
