## demos/c2d-led/boards/mimxrt1170_evk_mimxrt1176_cm7.conf
```kconfig
# MIMXRT1170-EVKB (Cortex-M7) board config for the c2d-led demo -- ETHERNET.
#
# RT1170-EVK's 100M ENET MAC + onboard PHY are status="okay" in the board DTS,
# so no overlay is needed. The board LED (alias led0 = green_led) is driven by
# the led-on/off/toggle C2D commands.
#
# Board target: mimxrt1170_evk/mimxrt1176/cm7 (revision B default).

# --- Bearer: native Ethernet (RT1170 ENET, RMII, onboard PHY) --------------
CONFIG_NET_L2_ETHERNET=y
CONFIG_ETH_NXP_ENET=y
CONFIG_MDIO=y

# --- IPv4 via DHCP; auto-bring-up the interface ----------------------------
CONFIG_NET_DHCPV4=y
CONFIG_NET_CONFIG_AUTO_INIT=y
CONFIG_NET_CONFIG_NEED_IPV4=y
CONFIG_NET_CONFIG_SETTINGS=y

# --- Net buffers sized for a wired link ------------------------------------
CONFIG_NET_PKT_RX_COUNT=16
CONFIG_NET_PKT_TX_COUNT=16
CONFIG_NET_BUF_RX_COUNT=32
CONFIG_NET_BUF_TX_COUNT=32
CONFIG_NET_CONTEXT_RCVTIMEO=y

# --- mbedTLS heap headroom for cloud broker cert chains --------------------
CONFIG_MBEDTLS_HEAP_SIZE=60000
```

## demos/c2d-led/boards/same54_xpro.conf
```kconfig
# SAM E54 Xplained Pro board config for the c2d-led demo -- ETHERNET bearer.
#
# The SAME54's GMAC is wired (RMII) to an onboard Microchip KSZ8091 PHY + RJ45,
# and the board devicetree already enables gmac/mdio/phy with the factory MAC
# address read from the onboard AT24MAC402 EEPROM (nvmem cell) -- so no overlay
# is needed. This .conf only turns on L2 + DHCPv4 so the interface
# self-configures and the SDK's connection manager sees L4 up.
#
# NOTE: this targets the legacy Atmel-tree board (`same54_xpro`), which has
# working Ethernet in Zephyr v4.4.1. Microchip's new-tree port of the same
# hardware (`sam_e54_xpro`) has no GMAC node yet; migrate when it lands.

# --- Bearer: native Ethernet (GMAC + KSZ8091 RMII) --------------------------
CONFIG_NET_L2_ETHERNET=y
CONFIG_ETH_SAM_GMAC=y
CONFIG_MDIO=y

# --- IPv4 via DHCP; auto-bring-up the interface ----------------------------
CONFIG_NET_DHCPV4=y
CONFIG_NET_CONFIG_AUTO_INIT=y
CONFIG_NET_CONFIG_NEED_IPV4=y
CONFIG_NET_CONFIG_SETTINGS=y

# --- Net buffers sized for a wired link ------------------------------------
CONFIG_NET_PKT_RX_COUNT=16
CONFIG_NET_PKT_TX_COUNT=16
CONFIG_NET_BUF_RX_COUNT=32
CONFIG_NET_BUF_TX_COUNT=32
CONFIG_NET_CONTEXT_RCVTIMEO=y

# --- mbedTLS heap headroom for cloud broker cert chains --------------------
CONFIG_MBEDTLS_HEAP_SIZE=60000

# --- Software-crypto speed (no HW accel on SAME54) --------------------------
# Without the NIST-curve optimization, the ECDHE/ECDSA TLS handshake on this
# 120 MHz M4F overruns AWS IoT's ~10 s handshake window and mqtt_connect
# fails with -116 (hardware-observed). ROM AES tables trade flash for setup time.
CONFIG_MBEDTLS_ECP_NIST_OPTIM=y
CONFIG_MBEDTLS_AES_ROM_TABLES=y
```

## demos/c2d-led/sample.yaml
```yaml
sample:
  name: IOTCONNECT c2d-led demo
  description: >
    Drive the board LED from /IOTCONNECT cloud-to-device commands and report LED
    state as telemetry. Built on the iotc-zephyr-sdk.
tests:
  sample.iotconnect.c2d_led:
    harness: net
    platform_allow:
      - frdm_mcxn947/mcxn947/cpu0
    tags:
      - iotconnect
      - net
      - gpio
```

## demos/telemetry/boards/frdm_imx93_mimx9352_a55.conf
```kconfig
# FRDM-IMX93 Cortex-A55 (arm64) board config for the telemetry demo -- ETHERNET.
#
# The i.MX93's Ethernet + Zephyr net support live on the A55 (the M33 has no
# Ethernet). The board DTS already enables the ENET MAC (RGMII) + Motorcomm
# YT8521 PHY, so this .conf just selects the NXP ENET driver + L2 + DHCPv4. The
# A55 runs bare-metal Zephyr from DRAM (U-Boot inits DDR, then the image is
# loaded to 0xd0000000), so there is NO NOR flash / NVS: identity comes from the
# compiled-in creds header (device_credentials.h), not runtime provisioning.
#
# Board target: frdm_imx93/mimx9352/a55  (needs the aarch64-zephyr-elf toolchain)

# --- Bearer: native Ethernet (i.MX93 ENET, RGMII, Motorcomm YT8521 PHY) -----
CONFIG_NET_L2_ETHERNET=y
CONFIG_ETH_NXP_ENET=y
CONFIG_MDIO=y

# --- IPv4 via DHCP; auto-bring-up the interface ----------------------------
CONFIG_NET_DHCPV4=y
CONFIG_NET_CONFIG_AUTO_INIT=y
CONFIG_NET_CONFIG_NEED_IPV4=y
CONFIG_NET_CONFIG_SETTINGS=y

# --- Net buffers sized for a wired (gigabit-capable) link ------------------
CONFIG_NET_PKT_RX_COUNT=16
CONFIG_NET_PKT_TX_COUNT=16
CONFIG_NET_BUF_RX_COUNT=32
CONFIG_NET_BUF_TX_COUNT=32
CONFIG_NET_CONTEXT_RCVTIMEO=y

# --- mbedTLS heap headroom for cloud broker cert chains --------------------
CONFIG_MBEDTLS_HEAP_SIZE=60000

# --- No NOR flash / NVS on this bare-metal A55 target: drop the persistence
#     stack and use the compiled-in identity (device_credentials.h). ---------
CONFIG_SETTINGS=n
CONFIG_SETTINGS_NVS=n
CONFIG_NVS=n
CONFIG_FLASH=n
CONFIG_FLASH_MAP=n
```

## demos/telemetry/sample.yaml
```yaml
sample:
  name: IOTCONNECT telemetry demo
  description: >
    Connect to /IOTCONNECT and publish periodic telemetry over MQTT/TLS. Reuses
    the iotc-zephyr-sdk telemetry sample app; per-board bearer in boards/.
tests:
  sample.iotconnect.telemetry:
    harness: net
    platform_allow:
      - frdm_mcxn947/mcxn947/cpu0
    tags:
      - iotconnect
      - net
```
