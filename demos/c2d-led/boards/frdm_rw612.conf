## demos/kinetis-meter/Kconfig
```kconfig
# Soft-AP provisioning demo options.

config SOFTAP_PROV_WIFI_FALLBACK_TIMEOUT
	int "Seconds to wait for the stored Wi-Fi before reopening the portal"
	default 90
	help
	  A provisioned device that cannot join its stored network within
	  this time (moved device, replaced router, changed passphrase)
	  reopens the setup access point so the Wi-Fi credentials can be
	  updated from a phone. The device identity and cloud configuration
	  are kept.

config METER_UART_POLL_CHAR
	string "Meter poll command character"
	default "0"
	help
	  Sent on the meter UART every poll interval. The NXP EasyEVSE
	  (TWR-KM35) firmware replies to '0' with all readings. Set empty
	  to disable polling for free-running JSON meters.

config METER_UART_POLL_INTERVAL
	int "Meter poll interval (seconds)"
	default 5

source "Kconfig.zephyr"
```

## demos/softap-provisioning/Kconfig
```kconfig
# Soft-AP provisioning demo options.

config SOFTAP_PROV_WIFI_FALLBACK_TIMEOUT
	int "Seconds to wait for the stored Wi-Fi before reopening the portal"
	default 90
	help
	  A provisioned device that cannot join its stored network within
	  this time (moved device, replaced router, changed passphrase)
	  reopens the setup access point so the Wi-Fi credentials can be
	  updated from a phone. The device identity and cloud configuration
	  are kept.

source "Kconfig.zephyr"
```
