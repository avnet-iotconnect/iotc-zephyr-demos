## CMakeLists.txt
```
# vision-occupancy demo: edge person detection on the MIMXRT1170-EVKB.
#
# Needs two modules on top of Zephyr:
#   - iotc-zephyr-sdk (pass -DZEPHYR_EXTRA_MODULES=<path>/iotc-zephyr-sdk)
#   - tflite-micro (a Zephyr optional module; in this repo's west.yml, or in a
#     vanilla zephyrproject workspace:
#       west config manifest.project-filter -- +tflite-micro
#       west update tflite-micro)
# Build with the camera shield:
#   west build -b mimxrt1170_evk/mimxrt1176/cm7 --shield nxp_btb44_ov5640 ...
cmake_minimum_required(VERSION 3.20.0)
find_package(Zephyr REQUIRED HINTS $ENV{ZEPHYR_BASE})
project(iotc_demo_vision_occupancy)

if(NOT DEFINED ZEPHYR_TFLITE_MICRO_MODULE_DIR)
  message(FATAL_ERROR
    "tflite-micro module not in the workspace. Enable it with:\n"
    "  west config manifest.project-filter -- +tflite-micro\n"
    "  west update tflite-micro")
endif()

target_sources(app PRIVATE
  src/main.c
  src/vision_camera.c
  src/vision_infer.cpp
  src/model_store.c
  src/png_gray.c
)

include(${CMAKE_CURRENT_SOURCE_DIR}/../../common/cmake/iotc_sdk_samples.cmake)

# quickstart_credentials.h: PUBLIC CA roots only (no device key). The
# per-device key/cert is provisioned on-chip (iotcprov provision) into NVS.
target_include_directories(app PRIVATE
  ${IOTC_SDK_SAMPLES_DIR}/quickstart/src)

# Built-in model: embed the stock TFLM person-detect .tflite (int8, 96x96x1,
# Apache-2.0) straight from the tflite-micro module -- no binary in this repo.
set(PERSON_DETECT_TFLITE
  ${ZEPHYR_TFLITE_MICRO_MODULE_DIR}/tensorflow/lite/micro/models/person_detect.tflite)
generate_inc_file_for_target(app
  ${PERSON_DETECT_TFLITE}
  ${ZEPHYR_BINARY_DIR}/include/generated/person_detect_tflite.inc)
target_include_directories(app PRIVATE ${ZEPHYR_BINARY_DIR}/include/generated)
```

## sample.yaml
```
sample:
  name: IOTCONNECT vision-occupancy demo
  description: >
    Edge person detection on the MIMXRT1170-EVKB: OV5640 camera frames run
    through a TFLite-Micro person-detect CNN on-device; occupancy state,
    scores and latency stream to /IOTCONNECT. Cloud commands pull snapshots
    (chunked telemetry) and hot-swap the vision model (IOTV envelope,
    persisted to flash). Built on the iotc-zephyr-sdk.
tests:
  sample.iotconnect.vision_occupancy:
    harness: net
    platform_allow:
      - mimxrt1170_evk/mimxrt1176/cm7
    extra_args:
      - SHIELD=nxp_btb44_ov5640
    tags:
      - iotconnect
      - net
      - video
      - tflite-micro
```

## prj.conf
```kconfig
# vision-occupancy: edge person detection + /IOTCONNECT.
# Provisioning model = quickstart (identity in NVS, on-chip keygen, shell).
# Board-specific networking/camera sizing lives in boards/<board>.conf.

# --- SDK + cloud (identity provisioned at runtime) ---------------------------
CONFIG_IOTCONNECT=y
CONFIG_IOTCONNECT_DRA=y
CONFIG_IOTCONNECT_CT_AWS=y
CONFIG_IOTCONNECT_DRA_DISCOVERY_HOST="awsdiscovery.iotconnect.io"

# --- On-device provisioning (identity in NVS + shell commands) ---------------
CONFIG_IOTCONNECT_IDENTITY_NVS=y
CONFIG_IOTCONNECT_ONDEVICE_KEYGEN=y
CONFIG_IOTCONNECT_SHELL=y
CONFIG_MBEDTLS_USER_CONFIG_FILE="iotc_mbedtls_config.h"
CONFIG_PSA_WANT_ALG_ECDSA=y
CONFIG_PSA_WANT_KEY_TYPE_ECC_KEY_PAIR_GENERATE=y
CONFIG_PSA_WANT_KEY_TYPE_ECC_KEY_PAIR_EXPORT=y
CONFIG_PSA_WANT_ECC_SECP_R1_256=y

# --- Shell (base64 cert/key + JSON paste need generous buffers) --------------
CONFIG_SHELL=y
CONFIG_SHELL_CMD_BUFF_SIZE=3072
CONFIG_SHELL_BACKEND_SERIAL_RX_RING_BUFFER_SIZE=4096
CONFIG_KERNEL_SHELL=y
CONFIG_REBOOT=y

# --- Camera / video ----------------------------------------------------------
CONFIG_VIDEO=y
# Buffer pool sizing (frames live in SDRAM) is per-board: boards/<board>.conf.

# --- TFLite-Micro inference (person-detect CNN, CMSIS-NN kernels) ------------
CONFIG_CPP=y
CONFIG_STD_CPP17=y
CONFIG_TENSORFLOW_LITE_MICRO=y
CONFIG_TENSORFLOW_LITE_MICRO_CMSIS_NN_KERNELS=y
CONFIG_FPU=y

# --- Model transfer / persistence -------------------------------------------
CONFIG_BASE64=y

# Telemetry Files: snapshot PNGs upload straight into the platform's file
# panel (S3 + fu announce). Needs "File Support" ON in the device template.
# SigV4 signing uses PSA HMAC-SHA256.
CONFIG_IOTCONNECT_FILE_UPLOAD=y
CONFIG_PSA_WANT_ALG_HMAC=y
CONFIG_PSA_WANT_ALG_SHA_256=y
CONFIG_PSA_WANT_KEY_TYPE_HMAC=y
CONFIG_CRC=y

# --- Networking (native Zephyr IP stack) -------------------------------------
CONFIG_NETWORKING=y
CONFIG_NET_NATIVE=y
CONFIG_NET_IPV4=y
CONFIG_NET_IPV6=n
CONFIG_NET_TCP=y
CONFIG_NET_UDP=y
CONFIG_NET_SOCKETS=y
CONFIG_NET_SOCKETS_SOCKOPT_TLS=y
CONFIG_NET_SOCKETS_TLS_MAX_CONTEXTS=4
CONFIG_DNS_RESOLVER=y
CONFIG_NET_CONNECTION_MANAGER=y
CONFIG_NET_MGMT=y
CONFIG_NET_MGMT_EVENT=y
CONFIG_POSIX_API=y

# --- TLS / mbedTLS -----------------------------------------------------------
CONFIG_TLS_CREDENTIALS=y
CONFIG_MBEDTLS=y
CONFIG_MBEDTLS_ENABLE_HEAP=y
CONFIG_MBEDTLS_HEAP_SIZE=75000
CONFIG_MBEDTLS_SSL_MAX_CONTENT_LEN=16384
CONFIG_MBEDTLS_PEM_PARSE_C=y
CONFIG_MBEDTLS_SSL_SERVER_NAME_INDICATION=y
CONFIG_MBEDTLS_CIPHERSUITE_TLS_ECDHE_RSA_WITH_AES_128_GCM_SHA256=y
# discovery.iotconnect.io (production instances) only accepts TLS 1.2 CBC suites
CONFIG_MBEDTLS_CIPHERSUITE_TLS_ECDHE_RSA_WITH_AES_128_CBC_SHA256=y
CONFIG_MBEDTLS_CIPHERSUITE_TLS_ECDHE_ECDSA_WITH_AES_128_GCM_SHA256=y
CONFIG_ENTROPY_GENERATOR=y

# --- MQTT / HTTP / SNTP ------------------------------------------------------
CONFIG_MQTT_LIB=y
CONFIG_MQTT_LIB_TLS=y
CONFIG_MQTT_KEEPALIVE=30
CONFIG_HTTP_CLIENT=y
CONFIG_SNTP=y
CONFIG_POSIX_TIMERS=y

# Snapshot chunks: 1024 raw -> 1368 base64 + JSON envelope, so give the MQTT
# TX buffer headroom over its 1400-byte default.
CONFIG_IOTCONNECT_MQTT_TX_BUF_SIZE=2048

# --- Settings / NVS (identity + DRA cache persistence) -----------------------
CONFIG_SETTINGS=y
CONFIG_SETTINGS_NVS=y
CONFIG_NVS=y
CONFIG_FLASH=y
CONFIG_FLASH_MAP=y

# --- libc / heap / stacks ----------------------------------------------------
CONFIG_PICOLIBC_IO_FLOAT=y
CONFIG_MAIN_STACK_SIZE=12288
CONFIG_SHELL_STACK_SIZE=8192
CONFIG_HEAP_MEM_POOL_SIZE=65536
CONFIG_IOTCONNECT_THREAD_STACK_SIZE=6144

# --- Logging -----------------------------------------------------------------
CONFIG_LOG=y
# Deferred-mode buffer sized so a burst (e.g. logging a full presigned URL)
# is not silently dropped.
CONFIG_LOG_BUFFER_SIZE=16384
CONFIG_IOTCONNECT_LOG_LEVEL_INF=y

# --- Board LED (occupancy indicator) -----------------------------------------
CONFIG_GPIO=y

# Device vitals: append a "sys" object (CPU/heap/temp/uptime/reset) to telemetry.
CONFIG_IOTCONNECT_DEVICE_VITALS=y
```

## boards/mimxrt1170_evk_mimxrt1176_cm7.conf
```kconfig
# MIMXRT1170-EVKB (Cortex-M7) board config for the vision-occupancy demo.
#
# Camera: build with --shield nxp_btb44_ov5640 (the OV5640 module shipped with
# the EVK/EVKB, on the J2 connector via MIPI CSI-2). The shield overlay wires
# chosen zephyr,camera to the CSI; this .conf sizes the capture buffers.
# Ethernet: the RT1170-EVK's 100M ENET MAC + onboard PHY are status="okay" in
# the board DTS, so no overlay is needed for networking.
#
# Board target: mimxrt1170_evk/mimxrt1176/cm7 (revision B default).

# --- Video capture buffers ---------------------------------------------------
# 2x QVGA RGB565 frames (2 x 150 KB) + slack; the pool lives in SDRAM
# (zephyr,sram = &sdram0), where 64 MB leaves size uncritical. Sized to also
# fit 2x VGA if the capture format is bumped to 640x480.
# Sized for the pipeline's native 1280x720 BGRX32 ("XR24") x3 buffers (one
# held as the latest frame + two cycling in the DMA) -- the hardware-observed
# default format; QVGA RGB565 is not accepted by this CSI chain.
CONFIG_VIDEO_BUFFER_POOL_HEAP_SIZE=11300000
CONFIG_VIDEO_BUFFER_POOL_NUM_MAX=4
CONFIG_VIDEO_BUFFER_POOL_ALIGN=64
CONFIG_DMA=y

# --- Bearer: native Ethernet (RT1170 ENET, RMII, onboard PHY) ----------------
CONFIG_NET_L2_ETHERNET=y
CONFIG_ETH_NXP_ENET=y
CONFIG_MDIO=y

# --- IPv4 via DHCP; auto-bring-up the interface ------------------------------
CONFIG_NET_DHCPV4=y
CONFIG_NET_CONFIG_AUTO_INIT=y
CONFIG_NET_CONFIG_NEED_IPV4=y
CONFIG_NET_CONFIG_SETTINGS=y
# Bench diagnostics: `net iface` / `net dhcpv4` / ping from the shell.
CONFIG_NET_SHELL=y
CONFIG_NET_DHCPV4_LOG_LEVEL_INF=y

# --- Net buffers sized for a wired link --------------------------------------
CONFIG_NET_PKT_RX_COUNT=16
CONFIG_NET_PKT_TX_COUNT=16
CONFIG_NET_BUF_RX_COUNT=32
CONFIG_NET_BUF_TX_COUNT=32
CONFIG_NET_CONTEXT_RCVTIMEO=y

# Connection/context tables sized for MQTT + DHCP + DNS + back-to-back HTTPS
# (credentials GET then S3 PUT, with the closed socket lingering in
# TIME_WAIT). The IPv4-only default NET_MAX_CONN=4 is exhausted exactly at
# the S3 connect (hardware-observed instant -ENOENT).
CONFIG_NET_MAX_CONN=16
CONFIG_NET_MAX_CONTEXTS=12

# --- mbedTLS heap headroom for cloud broker cert chains ----------------------
CONFIG_MBEDTLS_HEAP_SIZE=60000
```

## src/model_store.c
```c
/*
 * Copyright (c) 2026 Avnet, Inc.
 * SPDX-License-Identifier: MIT
 */
#include <string.h>

#include <zephyr/kernel.h>
#include <zephyr/logging/log.h>
#include <zephyr/storage/flash_map.h>
#include <zephyr/sys/crc.h>

#include "model_store.h"

LOG_MODULE_REGISTER(model_store, LOG_LEVEL_INF);

BUILD_ASSERT(sizeof(struct iotv_hdr) == IOTV_HDR_LEN, "IOTV header is 32 B");

#define MODEL_PARTITION slot1_partition
#define FLASH_SECTOR    4096u

const char *iotv_validate(const uint8_t *buf, size_t len)
{
	const struct iotv_hdr *h = (const struct iotv_hdr *)buf;

	if (len < IOTV_HDR_LEN) {
		return "blob shorter than header";
	}
	if (memcmp(h->magic, IOTV_MAGIC, 4) != 0) {
		return "bad magic (want IOTV)";
	}
	if (h->fmt_ver != IOTV_FMT_VER) {
		return "unsupported IOTV format version";
	}
	if (h->model_len == 0 || h->model_len > MODEL_MAX_BLOB - IOTV_HDR_LEN) {
		return "model length out of range";
	}
	if (len != IOTV_HDR_LEN + h->model_len) {
		return "length does not match header";
	}
	if (crc32_ieee(buf + IOTV_HDR_LEN, h->model_len) != h->crc) {
		return "payload CRC mismatch";
	}
	return NULL;
}

void iotv_wrap_in_place(uint8_t *buf, size_t payload_len, uint16_t model_ver,
			const char *name)
{
	struct iotv_hdr *h = (struct iotv_hdr *)buf;

	memcpy(h->magic, IOTV_MAGIC, 4);
	h->fmt_ver = IOTV_FMT_VER;
	h->model_ver = model_ver;
	h->model_len = (uint32_t)payload_len;
	h->crc = crc32_ieee(buf + IOTV_HDR_LEN, payload_len);
	memset(h->name, 0, sizeof(h->name));
	strncpy(h->name, name, sizeof(h->name) - 1);
}

int model_store_save(const uint8_t *iotv_blob, size_t len)
{
	const struct flash_area *fa;
	size_t erase_len = ROUND_UP(len, FLASH_SECTOR);
	int ret;

	ret = flash_area_open(PARTITION_ID(MODEL_PARTITION), &fa);
	if (ret != 0) {
		return ret;
	}
	if (erase_len > fa->fa_size) {
		flash_area_close(fa);
		return -EFBIG;
	}

	LOG_INF("persisting model (%u B; erasing %u B first)...",
		(unsigned int)len, (unsigned int)erase_len);
	ret = flash_area_erase(fa, 0, erase_len);
	if (ret == 0) {
		ret = flash_area_write(fa, 0, iotv_blob, len);
	}
	flash_area_close(fa);
	if (ret != 0) {
		LOG_ERR("model persist failed (%d)", ret);
	} else {
		LOG_INF("model persisted to " STRINGIFY(MODEL_PARTITION));
	}
	return ret;
}

int model_store_load(uint8_t *buf, size_t buf_size, size_t *out_len)
{
	const struct flash_area *fa;
	struct iotv_hdr hdr;
	const char *err;
	size_t total;
	int ret;

	ret = flash_area_open(PARTITION_ID(MODEL_PARTITION), &fa);
	if (ret != 0) {
		return ret;
	}

	ret = flash_area_read(fa, 0, &hdr, sizeof(hdr));
	if (ret != 0) {
		goto out;
	}
	if (memcmp(hdr.magic, IOTV_MAGIC, 4) != 0) {
		ret = -ENOENT; /* empty/erased store: not an error */
		goto out;
	}
	if (hdr.fmt_ver != IOTV_FMT_VER ||
	    hdr.model_len == 0 || hdr.model_len > MODEL_MAX_BLOB - IOTV_HDR_LEN) {
		LOG_WRN("stored model header invalid; ignoring");
		ret = -ENOENT;
		goto out;
	}
	total = IOTV_HDR_LEN + hdr.model_len;
	if (total > buf_size) {
		ret = -ENOMEM;
		goto out;
	}

	ret = flash_area_read(fa, 0, buf, total);
	if (ret != 0) {
		goto out;
	}
	err = iotv_validate(buf, total);
	if (err != NULL) {
		LOG_WRN("stored model rejected: %s", err);
		ret = -ENOENT;
		goto out;
	}
	*out_len = total;

out:
	flash_area_close(fa);
	return ret;
}

int model_store_erase(void)
{
	const struct flash_area *fa;
	int ret;

	ret = flash_area_open(PARTITION_ID(MODEL_PARTITION), &fa);
	if (ret != 0) {
		return ret;
	}
	ret = flash_area_erase(fa, 0, FLASH_SECTOR);
	flash_area_close(fa);
	return ret;
}
```

## src/model_store.h
```c
/*
 * Copyright (c) 2026 Avnet, Inc.
 * SPDX-License-Identifier: MIT
 *
 * IOTV model envelope + on-flash persistence for cloud-pushed vision models.
 *
 * A vision model travels as an "IOTV" blob: a 32-byte header (magic, format
 * version, model version, display name, payload length, CRC32) followed by
 * the raw .tflite flatbuffer. tools/pack_model.py builds one. The envelope
 * carries the same validation discipline as the ml-model-update demo's IOTM
 * format, scaled up from 124-byte MLPs to ~300 KB CNNs.
 *
 * Persistence: NVS/settings items are capped well below 300 KB, so pushed
 * models are stored raw in the slot1_partition (7 MB, unused by these
 * no-MCUboot demos) via the flash-area API. If this demo is ever combined
 * with MCUboot dual-slot OTA, move the store to a dedicated partition.
 */
#ifndef MODEL_STORE_H
#define MODEL_STORE_H

#include <stddef.h>
#include <stdint.h>

#ifdef __cplusplus
extern "C" {
#endif

#define IOTV_MAGIC   "IOTV"
#define IOTV_FMT_VER 1
#define IOTV_HDR_LEN 32

/* Staging/store ceiling for one enveloped model (header + .tflite). */
#define MODEL_MAX_BLOB (512 * 1024)

struct iotv_hdr {
	char magic[4];       /* "IOTV" */
	uint16_t fmt_ver;    /* IOTV_FMT_VER */
	uint16_t model_ver;  /* monotonic, chosen at pack time */
	uint32_t model_len;  /* payload (.tflite) length in bytes */
	uint32_t crc;        /* IEEE CRC32 over the payload */
	char name[16];       /* NUL-padded display name */
} __packed;

/* NULL when buf holds a well-formed IOTV blob, else a short reason. */
const char *iotv_validate(const uint8_t *buf, size_t len);

/*
 * Wrap a raw .tflite (already sitting at buf + IOTV_HDR_LEN, payload_len
 * bytes) with an IOTV header in place. Used to normalize raw-flatbuffer
 * pushes so everything downstream handles one format.
 */
void iotv_wrap_in_place(uint8_t *buf, size_t payload_len, uint16_t model_ver,
			const char *name);

/* Persist a validated IOTV blob to the model partition. Returns 0 or -errno.
 * Erases the required range first; several seconds for a ~300 KB model. */
int model_store_save(const uint8_t *iotv_blob, size_t len);

/*
 * Load the persisted IOTV blob into buf (buf_size >= MODEL_MAX_BLOB).
 * Returns 0 and sets *out_len when a valid blob was restored; -ENOENT when
 * the store is empty/invalid; other -errno on flash errors.
 */
int model_store_load(uint8_t *buf, size_t buf_size, size_t *out_len);

/* Invalidate the store (erase the header sector). Returns 0 or -errno. */
int model_store_erase(void);

#ifdef __cplusplus
}
#endif

#endif /* MODEL_STORE_H */
```

## src/png_gray.c
```c
/*
 * Copyright (c) 2026 Avnet, Inc.
 * SPDX-License-Identifier: MIT
 */
#include <errno.h>
#include <string.h>

#include <zephyr/sys/byteorder.h>
#include <zephyr/sys/crc.h>
#include <zephyr/sys/util.h>

#include "png_gray.h"

/* Deflate "stored" blocks are capped at 65535 bytes each. */
#define STORED_BLOCK_MAX 65535U

struct png_writer {
	uint8_t *buf;
	size_t cap;
	size_t len;
	int err;
};

static void put_bytes(struct png_writer *w, const void *data, size_t n)
{
	if (w->err != 0) {
		return;
	}
	if (w->len + n > w->cap) {
		w->err = -ENOMEM;
		return;
	}
	memcpy(w->buf + w->len, data, n);
	w->len += n;
}

static void put_be32(struct png_writer *w, uint32_t v)
{
	uint8_t b[4];

	sys_put_be32(v, b);
	put_bytes(w, b, 4);
}

/* Write one PNG chunk: length, tag, payload, CRC32(tag+payload). */
static void put_chunk(struct png_writer *w, const char tag[4],
		      const uint8_t *payload, size_t n)
{
	put_be32(w, (uint32_t)n);

	size_t crc_start = w->len;

	put_bytes(w, tag, 4);
	put_bytes(w, payload, n);
	if (w->err == 0) {
		put_be32(w, crc32_ieee(w->buf + crc_start, 4 + n));
	}
}

int png_gray_encode(const uint8_t *gray, uint16_t w, uint16_t h,
		    uint8_t *out, size_t out_size)
{
	static const uint8_t magic[8] = { 0x89, 'P', 'N', 'G',
					  '\r', '\n', 0x1a, '\n' };
	struct png_writer pw = { .buf = out, .cap = out_size };
	uint8_t ihdr[13];

	put_bytes(&pw, magic, sizeof(magic));

	sys_put_be32(w, &ihdr[0]);
	sys_put_be32(h, &ihdr[4]);
	ihdr[8] = 8;  /* bit depth */
	ihdr[9] = 0;  /* color type: grayscale */
	ihdr[10] = 0; /* compression */
	ihdr[11] = 0; /* filter */
	ihdr[12] = 0; /* interlace */
	put_chunk(&pw, "IHDR", ihdr, sizeof(ihdr));

	/*
	 * IDAT: a raw zlib stream of stored deflate blocks over the scanline
	 * data (each row prefixed with filter byte 0). Build the IDAT chunk
	 * in place: reserve the length/tag, stream the blocks, then patch
	 * length + CRC + append Adler-32.
	 */
	size_t raw_total = ((size_t)w + 1) * h;
	size_t idat_len_pos = pw.len;

	put_be32(&pw, 0);            /* chunk length, patched below */
	size_t idat_tag_pos = pw.len;

	put_bytes(&pw, "IDAT", 4);

	/* zlib header: 32K window, no preset dict, check bits valid. */
	static const uint8_t zhdr[2] = { 0x78, 0x01 };

	put_bytes(&pw, zhdr, sizeof(zhdr));

	uint32_t adler_a = 1, adler_b = 0;
	size_t emitted = 0;
	uint16_t row = 0;
	uint16_t col = 0; /* 0 = filter byte pending, else 1 + pixel index */

	while (emitted < raw_total) {
		size_t block = MIN(raw_total - emitted, (size_t)STORED_BLOCK_MAX);
		uint8_t bhdr[5];

		bhdr[0] = (emitted + block == raw_total) ? 1 : 0; /* BFINAL */
		sys_put_le16((uint16_t)block, &bhdr[1]);
		sys_put_le16((uint16_t)~block, &bhdr[3]);
		put_bytes(&pw, bhdr, sizeof(bhdr));

		for (size_t i = 0; i < block; i++) {
			uint8_t byte;

			if (col == 0) {
				byte = 0; /* filter: none */
				col = 1;
			} else {
				byte = gray[(size_t)row * w + (col - 1)];
				if (++col == (uint16_t)(w + 1)) {
					col = 0;
					row++;
				}
			}
			put_bytes(&pw, &byte, 1);
			/* Adler-32 (mod every step: sizes here stay small). */
			adler_a = (adler_a + byte) % 65521U;
			adler_b = (adler_b + adler_a) % 65521U;
		}
		emitted += block;
	}
	put_be32(&pw, (adler_b << 16) | adler_a);

	if (pw.err != 0) {
		return pw.err;
	}

	/* Patch IDAT length and append its CRC. */
	size_t idat_payload = pw.len - idat_tag_pos - 4;

	sys_put_be32((uint32_t)idat_payload, pw.buf + idat_len_pos);
	put_be32(&pw, crc32_ieee(pw.buf + idat_tag_pos, 4 + idat_payload));

	put_chunk(&pw, "IEND", NULL, 0);

	return (pw.err == 0) ? (int)pw.len : pw.err;
}
```

## src/png_gray.h
```c
/*
 * Copyright (c) 2026 Avnet, Inc.
 * SPDX-License-Identifier: MIT
 *
 * Minimal 8-bit grayscale PNG encoder using stored (uncompressed) deflate
 * blocks -- no zlib dependency, just CRC32 (zephyr sys/crc) and an inline
 * Adler-32. Output size ~= w*h + h + 90 bytes.
 */
#ifndef PNG_GRAY_H
#define PNG_GRAY_H

#include <stddef.h>
#include <stdint.h>

#ifdef __cplusplus
extern "C" {
#endif

/* Worst-case encoded size for a w x h frame (header + stored blocks). */
#define PNG_GRAY_MAX_SIZE(w, h) ((size_t)(w) * (h) + (h) + 128)

/*
 * Encode gray (w*h bytes, row-major) into out. Returns the PNG byte count,
 * or a negative errno (-ENOMEM if out_size is too small).
 */
int png_gray_encode(const uint8_t *gray, uint16_t w, uint16_t h,
		    uint8_t *out, size_t out_size);

#ifdef __cplusplus
}
#endif

#endif /* PNG_GRAY_H */
```

## src/vision_camera.c
```c
/*
 * Copyright (c) 2026 Avnet, Inc.
 * SPDX-License-Identifier: MIT
 */
#include <string.h>

#include <zephyr/kernel.h>
#include <zephyr/device.h>
#include <zephyr/drivers/video.h>
#include <zephyr/logging/log.h>

#include "vision_camera.h"

LOG_MODULE_REGISTER(vision_cam, LOG_LEVEL_INF);

#if !DT_HAS_CHOSEN(zephyr_camera)
#error "No camera in devicetree. Build with --shield nxp_btb44_ov5640 (RT1170-EVKB)."
#endif

#define CAPTURE_W 320
#define CAPTURE_H 240
/* 3 buffers: one held as the latest complete frame, two cycling in the
 * capture DMA. With only two, the pipeline starves the moment a frame is
 * held (or simply never dequeued) -- hardware-observed to wedge the whole
 * system after a few minutes. */
#define NUM_BUFS  3

static const struct device *const camera_dev =
	DEVICE_DT_GET(DT_CHOSEN(zephyr_camera));

static struct video_format cam_fmt = {
	.type = VIDEO_BUF_TYPE_OUTPUT,
};

/*
 * Drain thread: continuously dequeues finished frames and re-enqueues the
 * previously held one, so the capture DMA always has buffers regardless of
 * how often (or whether) the app consumes frames. Consumers convert straight
 * out of `latest` under the lock.
 */
static K_MUTEX_DEFINE(latest_lock);
static struct video_buffer *latest;
static volatile bool cam_stopped;
static struct k_thread drain_thread;
static K_THREAD_STACK_DEFINE(drain_stack, 2048);

static void drain_fn(void *a, void *b, void *c)
{
	ARG_UNUSED(a);
	ARG_UNUSED(b);
	ARG_UNUSED(c);

	while (!cam_stopped) {
		struct video_buffer *vbuf = &(struct video_buffer){};
		struct video_buffer *old = NULL;

		vbuf->type = VIDEO_BUF_TYPE_OUTPUT;
		if (video_dequeue(camera_dev, &vbuf, K_MSEC(1000)) != 0) {
			continue;
		}
		k_mutex_lock(&latest_lock, K_FOREVER);
		old = latest;
		latest = vbuf;
		k_mutex_unlock(&latest_lock);
		if (old != NULL) {
			old->type = VIDEO_BUF_TYPE_OUTPUT;
			if (video_enqueue(camera_dev, old) != 0) {
				LOG_WRN("re-enqueue failed");
			}
		}
	}
}

/* --- pixel -> luma helpers -------------------------------------------------- */

/* RGB565 (little-endian in the buffer) to 8-bit luma: 0.30 R 0.59 G 0.11 B. */
static inline uint8_t rgb565_luma(const uint8_t *p)
{
	uint16_t v = (uint16_t)p[0] | ((uint16_t)p[1] << 8);
	uint8_t r = (uint8_t)(((v >> 11) & 0x1F) << 3);
	uint8_t g = (uint8_t)(((v >> 5) & 0x3F) << 2);
	uint8_t b = (uint8_t)((v & 0x1F) << 3);

	return (uint8_t)((r * 77 + g * 150 + b * 29) >> 8);
}

/* Luma of pixel x in a YUYV pair array: Y bytes sit at even offsets. */
static inline uint8_t yuyv_luma(const uint8_t *line, uint32_t x)
{
	return line[x * 2];
}

/* BGRX32 ("XR24", the RT1170 CSI pipeline default): bytes are B,G,R,X. */
static inline uint8_t bgrx32_luma(const uint8_t *p)
{
	return (uint8_t)((p[2] * 77 + p[1] * 150 + p[0] * 29) >> 8);
}

static inline uint8_t pix_luma(const uint8_t *line, uint32_t x)
{
	switch (cam_fmt.pixelformat) {
	case VIDEO_PIX_FMT_YUYV:
		return yuyv_luma(line, x);
	case VIDEO_PIX_FMT_BGRX32:
		return bgrx32_luma(line + x * 4);
	default:
		return rgb565_luma(line + x * 2);
	}
}

/* --- init ------------------------------------------------------------------- */

int vision_camera_init(void)
{
	struct video_caps caps = {
		.type = VIDEO_BUF_TYPE_OUTPUT,
	};
	int ret;

	if (!device_is_ready(camera_dev)) {
		LOG_ERR("camera %s not ready", camera_dev->name);
		return -ENODEV;
	}

	ret = video_get_caps(camera_dev, &caps);
	if (ret < 0) {
		LOG_ERR("video_get_caps failed (%d)", ret);
		return ret;
	}

	ret = video_get_format(camera_dev, &cam_fmt);
	if (ret < 0) {
		LOG_ERR("video_get_format failed (%d)", ret);
		return ret;
	}

	/* Ask for QVGA RGB565; fall back to the pipeline's own default. Either
	 * way the format must be SET successfully -- a set_compose_format call
	 * is what programs the sensor + CSI chain coherently, and streaming
	 * without one leaves the capture DMA misconfigured (hardware-observed:
	 * no frames, then memory corruption). */
	cam_fmt.width = CAPTURE_W;
	cam_fmt.height = CAPTURE_H;
	cam_fmt.pixelformat = VIDEO_PIX_FMT_RGB565;
	ret = video_set_compose_format(camera_dev, &cam_fmt);
	if (ret < 0) {
		LOG_WRN("QVGA RGB565 not accepted (%d); using driver default", ret);
		ret = video_get_format(camera_dev, &cam_fmt);
		if (ret < 0) {
			return ret;
		}
		ret = video_set_compose_format(camera_dev, &cam_fmt);
		if (ret < 0) {
			LOG_ERR("cannot program default format either (%d)", ret);
			return ret;
		}
	}
	ret = video_get_format(camera_dev, &cam_fmt);
	if (ret < 0) {
		return ret;
	}

	if (cam_fmt.pixelformat != VIDEO_PIX_FMT_RGB565 &&
	    cam_fmt.pixelformat != VIDEO_PIX_FMT_YUYV &&
	    cam_fmt.pixelformat != VIDEO_PIX_FMT_BGRX32) {
		LOG_ERR("unsupported pixel format %s",
			VIDEO_FOURCC_TO_STR(cam_fmt.pixelformat));
		return -ENOTSUP;
	}
	if (cam_fmt.width < VISION_INPUT_W || cam_fmt.height < VISION_INPUT_H) {
		LOG_ERR("capture %ux%u smaller than model input",
			cam_fmt.width, cam_fmt.height);
		return -ENOTSUP;
	}

	LOG_INF("camera %s: %s %ux%u (pitch %u)", camera_dev->name,
		VIDEO_FOURCC_TO_STR(cam_fmt.pixelformat),
		cam_fmt.width, cam_fmt.height, cam_fmt.pitch);

	if (caps.min_vbuf_count > NUM_BUFS) {
		LOG_ERR("driver needs %u buffers, have %u",
			caps.min_vbuf_count, NUM_BUFS);
		return -EINVAL;
	}

	for (int i = 0; i < NUM_BUFS; i++) {
		struct video_buffer *vbuf;

		vbuf = video_buffer_aligned_alloc(cam_fmt.size,
						  CONFIG_VIDEO_BUFFER_POOL_ALIGN,
						  K_NO_WAIT);
		if (vbuf == NULL) {
			LOG_ERR("video buffer alloc failed (%u B); raise "
				"CONFIG_VIDEO_BUFFER_POOL_HEAP_SIZE", cam_fmt.size);
			return -ENOMEM;
		}
		vbuf->type = VIDEO_BUF_TYPE_OUTPUT;
		ret = video_enqueue(camera_dev, vbuf);
		if (ret < 0) {
			LOG_ERR("video_enqueue failed (%d)", ret);
			return ret;
		}
	}

	ret = video_stream_start(camera_dev, VIDEO_BUF_TYPE_OUTPUT);
	if (ret < 0) {
		LOG_ERR("video_stream_start failed (%d)", ret);
		return ret;
	}

	k_thread_create(&drain_thread, drain_stack,
			K_THREAD_STACK_SIZEOF(drain_stack), drain_fn,
			NULL, NULL, NULL, K_PRIO_PREEMPT(10), 0, K_NO_WAIT);
	k_thread_name_set(&drain_thread, "cam_drain");

	return 0;
}

void vision_camera_stop(void)
{
	/* Quiesce the drain thread and the capture DMA (e.g. after a failed
	 * self-test) so a broken pipeline cannot keep writing. */
	cam_stopped = true;
	k_thread_join(&drain_thread, K_MSEC(2500));
	(void)video_stream_stop(camera_dev, VIDEO_BUF_TYPE_OUTPUT);
}

void vision_camera_get_format(uint32_t *pixelformat, uint16_t *width,
			      uint16_t *height)
{
	if (pixelformat != NULL) {
		*pixelformat = cam_fmt.pixelformat;
	}
	if (width != NULL) {
		*width = (uint16_t)cam_fmt.width;
	}
	if (height != NULL) {
		*height = (uint16_t)cam_fmt.height;
	}
}

/* --- frame reduction -------------------------------------------------------- */

/*
 * Area-average a centered square crop of the frame down to 96x96 luma.
 * The crop is height x height pixels (the largest square), so the model sees
 * an undistorted view. Integer box averaging: each destination pixel averages
 * the source box it maps onto.
 */
static void frame_to_gray96(const uint8_t *buf, uint8_t *gray96)
{
	const uint32_t crop = cam_fmt.height;               /* square side */
	const uint32_t x0 = (cam_fmt.width - crop) / 2;     /* crop origin  */

	for (uint32_t dy = 0; dy < VISION_INPUT_H; dy++) {
		uint32_t sy0 = dy * crop / VISION_INPUT_H;
		uint32_t sy1 = (dy + 1) * crop / VISION_INPUT_H;

		if (sy1 == sy0) {
			sy1 = sy0 + 1;
		}
		for (uint32_t dx = 0; dx < VISION_INPUT_W; dx++) {
			uint32_t sx0 = x0 + dx * crop / VISION_INPUT_W;
			uint32_t sx1 = x0 + (dx + 1) * crop / VISION_INPUT_W;
			uint32_t acc = 0, n = 0;

			if (sx1 == sx0) {
				sx1 = sx0 + 1;
			}
			for (uint32_t sy = sy0; sy < sy1; sy++) {
				const uint8_t *line = buf + sy * cam_fmt.pitch;

				for (uint32_t sx = sx0; sx < sx1; sx++) {
					acc += pix_luma(line, sx);
					n++;
				}
			}
			gray96[dy * VISION_INPUT_W + dx] = (uint8_t)(acc / n);
		}
	}
}

/* Box-average the full frame to grayscale for the snapshot path. The
 * decimation factor adapts to the capture size (2 for QVGA, 8 for 720p) so
 * the result always fits SNAPSHOT_MAX_W x SNAPSHOT_MAX_H; actual dimensions
 * ride in the snapshot metadata. */
static void frame_to_snapshot(const uint8_t *buf, uint8_t *snap,
			      uint16_t *snap_w, uint16_t *snap_h)
{
	uint32_t d = MAX(DIV_ROUND_UP(cam_fmt.width, SNAPSHOT_MAX_W),
			 DIV_ROUND_UP(cam_fmt.height, SNAPSHOT_MAX_H));
	uint16_t w = (uint16_t)(cam_fmt.width / d);
	uint16_t h = (uint16_t)(cam_fmt.height / d);

	for (uint32_t dy = 0; dy < h; dy++) {
		for (uint32_t dx = 0; dx < w; dx++) {
			uint32_t acc = 0;

			for (uint32_t sy = dy * d; sy < (dy + 1) * d; sy++) {
				const uint8_t *line = buf + sy * cam_fmt.pitch;

				for (uint32_t sx = dx * d; sx < (dx + 1) * d; sx++) {
					acc += pix_luma(line, sx);
				}
			}
			snap[dy * w + dx] = (uint8_t)(acc / (d * d));
		}
	}
	*snap_w = w;
	*snap_h = h;
}

int vision_camera_capture(uint8_t *gray96, uint8_t *snap, uint16_t *snap_w,
			  uint16_t *snap_h, int timeout_ms)
{
	int64_t deadline = k_uptime_get() + timeout_ms;

	/* Convert from the drain thread's held frame; wait for the first one. */
	do {
		k_mutex_lock(&latest_lock, K_FOREVER);
		if (latest != NULL) {
			frame_to_gray96(latest->buffer, gray96);
			if (snap != NULL) {
				frame_to_snapshot(latest->buffer, snap,
						  snap_w, snap_h);
			}
			k_mutex_unlock(&latest_lock);
			return 0;
		}
		k_mutex_unlock(&latest_lock);
		k_sleep(K_MSEC(50));
	} while (k_uptime_get() < deadline);

	return -EAGAIN;
}
```

## src/vision_camera.h
```c
/*
 * Copyright (c) 2026 Avnet, Inc.
 * SPDX-License-Identifier: MIT
 *
 * Camera pipeline for the vision-occupancy demo.
 *
 * Wraps the Zephyr video API (chosen zephyr,camera -- on the RT1170-EVKB the
 * OV5640 shield module behind MIPI CSI-2) and reduces each captured frame to
 * the two things the app needs:
 *   - a 96x96 8-bit grayscale model input (area-averaged downscale of a
 *     center square crop), and
 *   - on request, a full-frame grayscale snapshot (2x2-decimated) for the
 *     cloud snapshot transfer.
 *
 * The capture format is requested as QVGA (320x240) RGB565; if the driver
 * negotiates something else the conversion adapts (RGB565 or YUYV, any
 * resolution >= 96x96).
 */
#ifndef VISION_CAMERA_H
#define VISION_CAMERA_H

#include <stddef.h>
#include <stdint.h>

#ifdef __cplusplus
extern "C" {
#endif

#define VISION_INPUT_W 96
#define VISION_INPUT_H 96
#define VISION_INPUT_LEN (VISION_INPUT_W * VISION_INPUT_H)

/* Snapshot output: capture frame decimated 2x2 (QVGA -> 160x120). */
#define SNAPSHOT_MAX_W 320
#define SNAPSHOT_MAX_H 180
#define SNAPSHOT_MAX_LEN (SNAPSHOT_MAX_W * SNAPSHOT_MAX_H)

/*
 * Initialize the camera: negotiate the format, allocate + enqueue capture
 * buffers, start streaming. Returns 0 on success or a negative errno.
 */
int vision_camera_init(void);

/* Stop streaming (quiesce capture DMA), e.g. after a failed self-test. */
void vision_camera_stop(void);

/* Negotiated capture format (valid after vision_camera_init). */
void vision_camera_get_format(uint32_t *pixelformat, uint16_t *width,
			      uint16_t *height);

/*
 * Capture one frame and downscale it into gray96 (VISION_INPUT_LEN bytes).
 *
 * If snap is non-NULL, the same frame is also decimated 2x2 to grayscale
 * into snap (up to SNAPSHOT_MAX_LEN bytes) and *snap_w / *snap_h are set.
 *
 * Blocks up to timeout_ms for the next frame. Returns 0 on success,
 * -EAGAIN on timeout, or a negative errno.
 */
int vision_camera_capture(uint8_t *gray96, uint8_t *snap, uint16_t *snap_w,
			  uint16_t *snap_h, int timeout_ms);

#ifdef __cplusplus
}
#endif

#endif /* VISION_CAMERA_H */
```

## src/vision_infer.cpp
```c
/*
 * Copyright (c) 2026 Avnet, Inc.
 * SPDX-License-Identifier: MIT
 */
#include <new>
#include <cstdio>
#include <cstring>

#include <zephyr/kernel.h>

#include <tensorflow/lite/micro/micro_mutable_op_resolver.h>
#include <tensorflow/lite/micro/micro_interpreter.h>
#include <tensorflow/lite/schema/schema_generated.h>

#include "vision_camera.h"
#include "vision_infer.h"

/*
 * Tensor arena for the person-detect MobileNet (int8, 96x96x1): the stock
 * model needs ~100 KB; leave headroom for cloud-pushed variants. Lives in
 * SDRAM (zephyr,sram = &sdram0 on the RT1170-EVK), so size is not precious.
 */
constexpr size_t kArenaSize = 192 * 1024;
static uint8_t tensor_arena[kArenaSize] __aligned(16);

/* Ops used by the person-detection MobileNet (visualize a candidate model
 * with netron.app to check it fits this set before pushing it). */
using VisionOpResolver = tflite::MicroMutableOpResolver<6>;

static VisionOpResolver op_resolver;
static bool ops_registered;

/* Interpreter storage for placement new/delete across model hot-swaps. */
alignas(tflite::MicroInterpreter) static uint8_t
	interp_mem[sizeof(tflite::MicroInterpreter)];
static tflite::MicroInterpreter *interp;

static void fail(char *err, size_t err_len, const char *msg)
{
	if (err != nullptr && err_len > 0) {
		std::snprintf(err, err_len, "%s", msg);
	}
}

extern "C" int vision_infer_init(const uint8_t *model_data, size_t model_len,
				 char *err, size_t err_len)
{
	ARG_UNUSED(model_len);

	const tflite::Model *model = tflite::GetModel(model_data);

	if (model->version() != TFLITE_SCHEMA_VERSION) {
		fail(err, err_len, "flatbuffer schema version mismatch");
		return -1;
	}

	if (!ops_registered) {
		op_resolver.AddConv2D();
		op_resolver.AddDepthwiseConv2D();
		op_resolver.AddAveragePool2D();
		op_resolver.AddFullyConnected();
		op_resolver.AddReshape();
		op_resolver.AddSoftmax();
		ops_registered = true;
	}

	if (interp != nullptr) {
		interp->~MicroInterpreter();
		interp = nullptr;
	}

	tflite::MicroInterpreter *ni = new (interp_mem) tflite::MicroInterpreter(
		model, op_resolver, tensor_arena, kArenaSize);

	if (ni->AllocateTensors() != kTfLiteOk) {
		ni->~MicroInterpreter();
		fail(err, err_len, "AllocateTensors failed (op set/arena)");
		return -1;
	}

	TfLiteTensor *in = ni->input(0);
	TfLiteTensor *out = ni->output(0);

	if (in == nullptr || out == nullptr ||
	    in->type != kTfLiteInt8 || out->type != kTfLiteInt8 ||
	    in->dims->size != 4 ||
	    in->dims->data[1] != VISION_INPUT_H ||
	    in->dims->data[2] != VISION_INPUT_W ||
	    in->dims->data[3] != 1 ||
	    out->dims->data[out->dims->size - 1] != 2) {
		ni->~MicroInterpreter();
		fail(err, err_len, "not an int8 96x96x1 2-class model");
		return -1;
	}

	interp = ni;
	return 0;
}

extern "C" int vision_infer_run(const uint8_t *gray96, int *person_pct,
				int *clear_pct, uint32_t *infer_ms)
{
	if (interp == nullptr) {
		return -1;
	}

	TfLiteTensor *in = interp->input(0);
	const float in_scale = in->params.scale;
	const int in_zp = in->params.zero_point;

	/* Quantize 0..255 luma into the input tensor. For the stock model
	 * (scale 1/255, zero point -128) this reduces to pixel - 128. */
	for (size_t i = 0; i < VISION_INPUT_LEN; i++) {
		int q = (int)((float)gray96[i] / 255.0f / in_scale + 0.5f) + in_zp;

		in->data.int8[i] = (int8_t)CLAMP(q, -128, 127);
	}

	int64_t t0 = k_uptime_get();

	if (interp->Invoke() != kTfLiteOk) {
		return -2;
	}
	if (infer_ms != nullptr) {
		*infer_ms = (uint32_t)(k_uptime_get() - t0);
	}

	/* Output: softmaxed int8 [no-person, person] (indices per the TFLM
	 * person_detection example's model_settings). */
	TfLiteTensor *out = interp->output(0);
	const float out_scale = out->params.scale;
	const int out_zp = out->params.zero_point;

	if (person_pct != nullptr) {
		*person_pct = (int)((out->data.int8[1] - out_zp) * out_scale * 100.0f);
	}
	if (clear_pct != nullptr) {
		*clear_pct = (int)((out->data.int8[0] - out_zp) * out_scale * 100.0f);
	}
	return 0;
}

extern "C" size_t vision_infer_arena_used(void)
{
	return (interp != nullptr) ? interp->arena_used_bytes() : 0;
}
```

## src/vision_infer.h
```c
/*
 * Copyright (c) 2026 Avnet, Inc.
 * SPDX-License-Identifier: MIT
 *
 * TFLite-Micro person-detection wrapper (C API over the C++ runtime).
 *
 * The model is DATA: vision_infer_init() builds a fresh interpreter over any
 * int8 96x96x1 person-detection .tflite flatbuffer (MobileNet-style, the ops
 * registered in vision_infer.cpp). Re-initializing with a new blob hot-swaps
 * the model; on failure the caller re-inits with the previous blob to roll
 * back. Calls are NOT thread-safe -- the app serializes them with its model
 * lock.
 */
#ifndef VISION_INFER_H
#define VISION_INFER_H

#include <stddef.h>
#include <stdint.h>

#ifdef __cplusplus
extern "C" {
#endif

/*
 * (Re)build the interpreter over model_data (a .tflite flatbuffer that must
 * stay resident -- TFLM references it in place). Verifies schema version,
 * arena fit, and a 96x96x1 int8 input / 2-class int8 output. Returns 0 on
 * success; on error returns a negative value and writes a short reason into
 * err (if non-NULL).
 */
int vision_infer_init(const uint8_t *model_data, size_t model_len,
		      char *err, size_t err_len);

/*
 * Run person detection on a 96x96 grayscale image (VISION_INPUT_LEN bytes,
 * row-major, 0..255).
 *
 * On success writes the person score in percent (0..100) to *person_pct,
 * the no-person score to *clear_pct, and the wall time of the invoke to
 * *infer_ms; returns 0. Returns a negative value if no model is loaded or
 * the invoke fails.
 */
int vision_infer_run(const uint8_t *gray96, int *person_pct, int *clear_pct,
		     uint32_t *infer_ms);

/* Tensor-arena bytes actually used by the current model (0 if none). */
size_t vision_infer_arena_used(void);

#ifdef __cplusplus
}
#endif

#endif /* VISION_INFER_H */
```
