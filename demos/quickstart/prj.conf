## CMakeLists.txt
```
# IOTCONNECT Zephyr quickstart -- flash-and-provision binary.
# The app source lives in iotc-zephyr-sdk/samples/quickstart; this demo
# supplies the per-board confs/overlays for the full board matrix.
cmake_minimum_required(VERSION 3.20.0)
find_package(Zephyr REQUIRED HINTS $ENV{ZEPHYR_BASE})
project(iotc_quickstart)

include(${CMAKE_CURRENT_SOURCE_DIR}/../../common/cmake/iotc_sdk_samples.cmake)

target_sources(app PRIVATE ${IOTC_SDK_SAMPLES_DIR}/quickstart/src/main.c)
```

## prj.conf
```kconfig
# IOTCONNECT Zephyr quickstart -- a flash-and-provision binary.
#
# No device identity is compiled in (cpid/env/duid empty). The device is
# provisioned entirely from the serial prompt: it generates its own key + cert
# (iotcprov provision), you register the cert, paste iotcDeviceConfig.json
# (iotc config), and reboot. Only the public CA roots are compiled in.
# Board-specific networking lives in boards/<board>.conf.

# --- SDK + cloud (region set at build time; identity provisioned at runtime) -
CONFIG_IOTCONNECT=y
CONFIG_IOTCONNECT_DRA=y
CONFIG_IOTCONNECT_CT_AWS=y
CONFIG_IOTCONNECT_DRA_DISCOVERY_HOST="awsdiscovery.iotconnect.io"

# --- On-device provisioning (identity in NVS + shell commands) --------------
CONFIG_IOTCONNECT_IDENTITY_NVS=y
CONFIG_IOTCONNECT_ONDEVICE_KEYGEN=y
CONFIG_IOTCONNECT_SHELL=y
CONFIG_MBEDTLS_USER_CONFIG_FILE="iotc_mbedtls_config.h"   # enables X509_CREATE_C
CONFIG_PSA_WANT_ALG_ECDSA=y
CONFIG_PSA_WANT_KEY_TYPE_ECC_KEY_PAIR_GENERATE=y
CONFIG_PSA_WANT_KEY_TYPE_ECC_KEY_PAIR_EXPORT=y
CONFIG_PSA_WANT_ECC_SECP_R1_256=y

# --- Shell (base64 cert/key + JSON paste need generous buffers) -------------
CONFIG_SHELL=y
CONFIG_SHELL_CMD_BUFF_SIZE=3072
CONFIG_SHELL_BACKEND_SERIAL_RX_RING_BUFFER_SIZE=4096
CONFIG_KERNEL_SHELL=y
CONFIG_REBOOT=y

# --- Networking (native Zephyr IP stack) -----------------------------------
CONFIG_NETWORKING=y
CONFIG_NET_NATIVE=y
CONFIG_NET_IPV4=y
CONFIG_NET_IPV6=n
CONFIG_NET_TCP=y
CONFIG_NET_UDP=y
CONFIG_NET_SOCKETS=y
CONFIG_NET_SOCKETS_SOCKOPT_TLS=y
CONFIG_NET_SOCKETS_TLS_MAX_CONTEXTS=4
CONFIG_DNS_RESOLVER=y
CONFIG_NET_CONNECTION_MANAGER=y
CONFIG_NET_MGMT=y
CONFIG_NET_MGMT_EVENT=y
CONFIG_POSIX_API=y

# --- TLS / mbedTLS ----------------------------------------------------------
CONFIG_TLS_CREDENTIALS=y
CONFIG_MBEDTLS=y
CONFIG_MBEDTLS_ENABLE_HEAP=y
CONFIG_MBEDTLS_HEAP_SIZE=75000
CONFIG_MBEDTLS_SSL_MAX_CONTENT_LEN=16384
CONFIG_MBEDTLS_PEM_PARSE_C=y
CONFIG_MBEDTLS_SSL_SERVER_NAME_INDICATION=y
CONFIG_MBEDTLS_CIPHERSUITE_TLS_ECDHE_RSA_WITH_AES_128_GCM_SHA256=y
# discovery.iotconnect.io (production instances) only accepts TLS 1.2 CBC suites
CONFIG_MBEDTLS_CIPHERSUITE_TLS_ECDHE_RSA_WITH_AES_128_CBC_SHA256=y
CONFIG_MBEDTLS_CIPHERSUITE_TLS_ECDHE_ECDSA_WITH_AES_128_GCM_SHA256=y
CONFIG_ENTROPY_GENERATOR=y

# --- MQTT / HTTP / SNTP -----------------------------------------------------
CONFIG_MQTT_LIB=y
CONFIG_MQTT_LIB_TLS=y
CONFIG_MQTT_KEEPALIVE=30
CONFIG_HTTP_CLIENT=y
CONFIG_SNTP=y
CONFIG_POSIX_TIMERS=y

# --- Settings / NVS ---------------------------------------------------------
CONFIG_SETTINGS=y
CONFIG_SETTINGS_NVS=y
CONFIG_NVS=y
CONFIG_FLASH=y
CONFIG_FLASH_MAP=y

# --- libc / heap / stacks (x509 write is stack-hungry) ----------------------
CONFIG_PICOLIBC_IO_FLOAT=y
CONFIG_MAIN_STACK_SIZE=8192
CONFIG_SHELL_STACK_SIZE=8192
CONFIG_HEAP_MEM_POOL_SIZE=32768
CONFIG_IOTCONNECT_THREAD_STACK_SIZE=4096

# --- Logging ----------------------------------------------------------------
CONFIG_LOG=y
CONFIG_IOTCONNECT_LOG_LEVEL_INF=y

# Device vitals: append a "sys" object (CPU/heap/temp/uptime/reset) to telemetry.
CONFIG_IOTCONNECT_DEVICE_VITALS=y
```

## boards/frdm_imx93_mimx9352_a55.conf
```kconfig
# FRDM-IMX93 Cortex-A55 quickstart -- flash-and-provision, releasable image.
#
# Same Zephyr-on-A55 Ethernet path as demos/telemetry, but built as the
# QUICKSTART: NO baked-in device identity (only public CA roots), on-device EC
# P-256 keygen + self-signed cert, and the `iotcprov`/`iotc` provisioning shell.
# Anyone can write this SD image, provision it to THEIR IOTCONNECT account, and
# it connects -- no toolchain, no recompile.
#
# The A55 runs bare-metal from DRAM with no on-chip NVS flash, so the provisioned
# identity is persisted to a reserved sector region on the boot SD (usdhc2, disk
# "SD") via the SDK's disk-backed identity store (CONFIG_IOTCONNECT_IDENTITY_DISK).
#
# Board target: frdm_imx93/mimx9352/a55  (needs the aarch64-zephyr-elf toolchain
# and `spsdk`; build with USE_NXP_SPSDK_IMAGE=y for the bootable flash.bin).

# --- Bearer: native Ethernet (i.MX93 ENET, RGMII, Motorcomm YT8521 PHY) -----
CONFIG_NET_L2_ETHERNET=y
CONFIG_ETH_NXP_ENET=y
CONFIG_MDIO=y
CONFIG_NET_DHCPV4=y
CONFIG_NET_CONFIG_AUTO_INIT=y
CONFIG_NET_CONFIG_NEED_IPV4=y
CONFIG_NET_CONFIG_SETTINGS=y
CONFIG_NET_PKT_RX_COUNT=16
CONFIG_NET_PKT_TX_COUNT=16
CONFIG_NET_BUF_RX_COUNT=32
CONFIG_NET_BUF_TX_COUNT=32
CONFIG_NET_CONTEXT_RCVTIMEO=y
CONFIG_MBEDTLS_HEAP_SIZE=60000

# --- Identity persistence: raw eMMC sector region (no NOR flash on this target).
#     The ROM boots from the removable SD (uSDHC2); the board doc says to use a
#     DIFFERENT uSDHC controller from Zephyr to avoid contending with the boot
#     controller, so we persist identity to the on-SOM eMMC (uSDHC1 -> disk
#     "SD2"). This overrides the settings/NVS backend the base prj.conf enables
#     for the MCU boards. -------------------------------------------------------
CONFIG_SETTINGS=n
CONFIG_SETTINGS_NVS=n
CONFIG_NVS=n
CONFIG_FLASH=n
CONFIG_FLASH_MAP=n
CONFIG_IOTCONNECT_IDENTITY_DISK=y
CONFIG_IOTCONNECT_IDENTITY_DISK_NAME="SD2"
# Reserve 16 sectors high on the 16 GB eMMC (sector 20,000,000 ~= 10 GB), well
# clear of any factory bootloader/partition table in the first few MB. The demo
# boots from the SD, so the eMMC user area is otherwise unused here.
CONFIG_IOTCONNECT_IDENTITY_DISK_SECTOR=20000000

# --- eMMC block access for the identity store (uSDHC1, on-SOM eMMC) ----------
CONFIG_DISK_ACCESS=y
CONFIG_DISK_DRIVER_MMC=y
CONFIG_MMC_STACK=y
CONFIG_SDHC=y
```

## boards/frdm_mcxn947_mcxn947_cpu0.conf
```kconfig
# FRDM-MCXN947 board overlay for the telemetry sample -- ETHERNET bearer.
#
# The MCXN947 ENET-QoS MAC is wired (RMII) to an onboard Microchip LAN8741 PHY
# + RJ45. The DT overlay (boards/frdm_mcxn947_mcxn947_cpu0.overlay) enables
# enet_mac / enet_mdio / phy; this .conf turns on the L2 + DHCPv4 so the
# interface self-configures and the SDK's connection manager sees L4 up.
#
# NOTE: if ENET init fails at boot with "Can't clear SWR", the RMII REF_CLK is
# not reaching the SoC. On FRDM-MCXN947 the usual cause is board rework: NXP's
# camera/LCD demo setups move solder jumpers that disconnect the ENET pins.
# The PHY still responds over MDIO and reports link, so it looks driver-side.

# --- Bearer: native Ethernet (ENET-QoS + LAN8741 RMII) ---------------------
CONFIG_NET_L2_ETHERNET=y
CONFIG_ETH_NXP_ENET_QOS=y
CONFIG_ETH_NXP_ENET_QOS_MAC=y
CONFIG_MDIO=y

# --- IPv4 via DHCP; auto-bring-up the interface ----------------------------
CONFIG_NET_DHCPV4=y
CONFIG_NET_CONFIG_AUTO_INIT=y
CONFIG_NET_CONFIG_NEED_IPV4=y
CONFIG_NET_CONFIG_SETTINGS=y

# --- Net buffers sized for a wired link ------------------------------------
CONFIG_NET_PKT_RX_COUNT=16
CONFIG_NET_PKT_TX_COUNT=16
CONFIG_NET_BUF_RX_COUNT=32
CONFIG_NET_BUF_TX_COUNT=32
CONFIG_NET_CONTEXT_RCVTIMEO=y

# --- mbedTLS heap headroom for cloud broker cert chains --------------------
CONFIG_MBEDTLS_HEAP_SIZE=60000

# --- Distributable artifact: emit zephyr.hex (addresses embedded) -----------
CONFIG_BUILD_OUTPUT_HEX=y
```

## boards/frdm_mcxn947_mcxn947_cpu0_ns.conf
```kconfig
# FRDM-MCXN947 /ns (TF-M) board config for the quickstart -- Ethernet +
# HARDWARE-BACKED key protection. Crypto/entropy run in the TF-M secure world,
# so the non-secure app's mbedTLS heap + TLS buffers are trimmed to fit the
# smaller non-secure RAM partition and 256 KB MCUboot slot.

# --- Bearer: native Ethernet (ENET-QoS + LAN8741 RMII) ---------------------
CONFIG_NET_L2_ETHERNET=y
CONFIG_ETH_NXP_ENET_QOS=y
CONFIG_ETH_NXP_ENET_QOS_MAC=y
CONFIG_MDIO=y
CONFIG_NET_DHCPV4=y
CONFIG_NET_CONFIG_AUTO_INIT=y
CONFIG_NET_CONFIG_NEED_IPV4=y
CONFIG_NET_CONFIG_SETTINGS=y

# --- TLS credentials live in RAM (VOLATILE backend). The device key is sealed
#     at rest in TF-M Protected Storage via the SDK identity blob; at connect
#     time it is loaded to RAM and referenced by the handshake. Do NOT use the
#     PROTECTED_STORAGE backend here: it would push all four TLS creds (broker
#     CA, DRA CA, device cert, device key) into the small TF-M PS partition,
#     overflow it, and leave the sec-tag empty (TLS_SEC_TAG_LIST -ENOENT). -----
CONFIG_TLS_CREDENTIALS_BACKEND_VOLATILE=y

# --- RNG: net stack sys_rand_get has no entropy device under TF-M -> timer.
#     Crypto uses the TF-M/PSA HW RNG. ----------------------------------------
CONFIG_TEST_RANDOM_GENERATOR=y
CONFIG_TIMER_RANDOM_GENERATOR=y

# --- Trim NS RAM (secure world holds the heavy crypto) ---------------------
CONFIG_MBEDTLS_HEAP_SIZE=22000
CONFIG_MBEDTLS_SSL_MAX_CONTENT_LEN=8192
CONFIG_HEAP_MEM_POOL_SIZE=12288
CONFIG_NET_PKT_RX_COUNT=16
CONFIG_NET_PKT_TX_COUNT=8
CONFIG_NET_BUF_RX_COUNT=48
CONFIG_NET_BUF_TX_COUNT=16

# --- Trim NS flash to fit the 256 KB non-secure MCUboot slot ---------------
CONFIG_SHELL_HELP=n
CONFIG_SHELL_HISTORY=n
CONFIG_SHELL_VT100_COMMANDS=n
CONFIG_SHELL_STATS=n
CONFIG_LOG_MODE_MINIMAL=y

# --- Keep the boot banner ON so we can see how far the NS app boots ---------
CONFIG_BOOT_BANNER=y

# --- ROOT-CAUSE FIX: the MCXN947 flash controller is unusable from the
#     non-secure world under TF-M, so the NS flash driver's PRE_KERNEL init
#     faults before the boot banner. Drop the entire NS flash/NVS/settings
#     stack; the device identity is sealed in TF-M PSA Protected Storage
#     instead (CONFIG_BUILD_WITH_TFM path in iotc_identity.c). --------------
CONFIG_FLASH=n
CONFIG_FLASH_MAP=n
CONFIG_NVS=n
CONFIG_SETTINGS=n
CONFIG_SETTINGS_NVS=n

# Quiet the ENET-QoS RX-starvation WRN so it does not flood the shell prompt
# (harmless LAN-broadcast drops while unprovisioned/idle).
CONFIG_ETHERNET_LOG_LEVEL_ERR=y


# --- TF-M PSA: to VERIFY the server's certificate chain and do the ECDHE key
#     agreement with the server's ephemeral public key, PSA must be able to
#     import PUBLIC keys. On-device keygen only enabled the *_KEY_PAIR types
#     (for our own key); without these the DRA/MQTT TLS handshake aborts
#     (-ECONNABORTED). Non-TF-M builds use software mbedTLS and don't need them.
CONFIG_PSA_WANT_KEY_TYPE_ECC_PUBLIC_KEY=y
CONFIG_PSA_WANT_KEY_TYPE_RSA_PUBLIC_KEY=y

# --- DIAGNOSTIC: surface the raw mbedTLS handshake error (sockets_tls.c logs
#     "TLS handshake error: -0x%x" at NET_ERR before masking it to ECONNABORTED)
CONFIG_NET_LOG=y
CONFIG_NET_SOCKETS_LOG_LEVEL_ERR=y

# --- TF-M PSA: a full TLS handshake needs SHA-384/512 (AWS commonly negotiates
#     ECDHE-RSA-AES256-GCM-SHA384; the PRF + cert/ServerKeyExchange signatures
#     use SHA-384) and P-384 for ECDHE/ECDSA on some chains. On-device keygen
#     only enabled SHA-256/P-256, so the handshake failed in a PSA hash op
#     (mbedTLS -0x7F80 HW_ACCEL_FAILED). ---------------------------------------
CONFIG_PSA_WANT_ALG_SHA_384=y
CONFIG_PSA_WANT_ALG_SHA_512=y
CONFIG_PSA_WANT_ECC_SECP_R1_384=y


# The DRA flow opens sequential TLS connections (discovery then identity);
# give the net stack enough connection + context slots (TIME_WAIT overlap).
CONFIG_NET_MAX_CONN=8
CONFIG_NET_MAX_CONTEXTS=8

# --- Stacks -----------------------------------------------------------------
# Keep the MPU stack guard on (clean overflow detection). The shell stack must
# fit on-device EC keygen (iotcprov keygen). The C2D worker cJSON-parses inbound
# commands off the MQTT pump thread; keep it at the SDK default (not trimmed).
CONFIG_MPU_STACK_GUARD=y
CONFIG_SHELL_STACK_SIZE=6144
CONFIG_IOTCONNECT_C2D_WORKQ_STACK_SIZE=3072
```

## boards/frdm_rw612.conf
```kconfig
# FRDM-RW612 board config for the quickstart demo -- WI-FI, runtime-provisioned.
#
# The RW612's onboard 2.4/5 GHz 802.11ax radio is driven by the in-tree NXP
# Wi-Fi driver. The Wi-Fi firmware is linked into the image (monolithic
# build), so fetch the binary blobs once before building:
#   west blobs fetch hal_nxp
# No devicetree overlay is needed -- the SoC's nxp,wifi node is enabled by
# default.
#
# NOTHING network-specific is compiled in: Wi-Fi credentials are entered at
# the shell and persist in the settings/NVS storage partition, so one binary
# works on any network (WPA2-PSK or open):
#   wifi cred add -s "<ssid>" -k 1 -p "<passphrase>"
# The SDK's Wi-Fi auto-connect (CONFIG_IOTCONNECT_WIFI_AUTOCONNECT) then
# associates at every boot from the stored credentials.
#
# Board target: frdm_rw612.

# --- Bearer: onboard Wi-Fi (NXP RW612, monolithic firmware) -----------------
CONFIG_WIFI=y
CONFIG_WIFI_NXP=y
CONFIG_NXP_RW610=y
CONFIG_ETH_DRIVER=n

# --- Runtime Wi-Fi provisioning (stored credentials + boot auto-connect) ----
CONFIG_WIFI_CREDENTIALS=y
CONFIG_WIFI_CREDENTIALS_BACKEND_SETTINGS=y
CONFIG_WIFI_CREDENTIALS_SHELL=y
CONFIG_NET_L2_WIFI_SHELL=y
CONFIG_NET_SHELL=y
CONFIG_IOTCONNECT_WIFI_AUTOCONNECT=y

# --- IPv4 via DHCP; auto-bring-up the interface ----------------------------
CONFIG_NET_DHCPV4=y
CONFIG_NET_CONFIG_AUTO_INIT=y
# Do not block boot waiting for the interface or an address: on first boot
# Wi-Fi is not yet provisioned and the shell must come up immediately (with a
# nonzero timeout, net_config stalls boot until the dormant Wi-Fi interface
# would come up). net_config still starts DHCP; the app waits for L4 via
# conn_mgr.
CONFIG_NET_CONFIG_NEED_IPV4=n
CONFIG_NET_CONFIG_INIT_TIMEOUT=0
CONFIG_NET_CONFIG_SETTINGS=y

# --- Net buffers / stacks sized for the Wi-Fi driver ------------------------
CONFIG_NET_PKT_RX_COUNT=16
CONFIG_NET_PKT_TX_COUNT=16
CONFIG_NET_BUF_RX_COUNT=32
CONFIG_NET_BUF_TX_COUNT=32
CONFIG_NET_CONTEXT_RCVTIMEO=y
CONFIG_NET_MGMT_EVENT_STACK_SIZE=4608
CONFIG_NET_TCP_WORKQ_STACK_SIZE=2048
CONFIG_SYSTEM_WORKQUEUE_STACK_SIZE=2048

# --- Heap: Wi-Fi driver needs ~50K on top of the app/mbedTLS usage ----------
CONFIG_HEAP_MEM_POOL_SIZE=98304

# --- mbedTLS heap headroom for cloud broker cert chains --------------------
CONFIG_MBEDTLS_HEAP_SIZE=90000

# --- Distributable artifact: emit zephyr.hex (addresses embedded) -----------
CONFIG_BUILD_OUTPUT_HEX=y
```

## boards/mimxrt1170_evk_mimxrt1176_cm7.conf
```kconfig
# MIMXRT1170-EVKB (Cortex-M7) board config for the telemetry demo -- ETHERNET.
#
# Unlike the MCXN947, the RT1170-EVK's 100M ENET MAC + onboard PHY are already
# status="okay" in the board DTS, so NO overlay is needed to bring up the link.
# This .conf just selects the NXP ENET driver + L2 and turns on DHCPv4 so the
# interface self-configures and the SDK's connection manager sees L4 up.
#
# Board target: mimxrt1170_evk/mimxrt1176/cm7 (revision B default).

# --- Bearer: native Ethernet (RT1170 ENET, RMII, onboard PHY) --------------
CONFIG_NET_L2_ETHERNET=y
CONFIG_ETH_NXP_ENET=y
CONFIG_MDIO=y

# --- IPv4 via DHCP; auto-bring-up the interface ----------------------------
CONFIG_NET_DHCPV4=y
CONFIG_NET_CONFIG_AUTO_INIT=y
CONFIG_NET_CONFIG_NEED_IPV4=y
CONFIG_NET_CONFIG_SETTINGS=y

# --- Net buffers sized for a wired link ------------------------------------
CONFIG_NET_PKT_RX_COUNT=16
CONFIG_NET_PKT_TX_COUNT=16
CONFIG_NET_BUF_RX_COUNT=32
CONFIG_NET_BUF_TX_COUNT=32
CONFIG_NET_CONTEXT_RCVTIMEO=y

# --- mbedTLS heap headroom for cloud broker cert chains --------------------
CONFIG_MBEDTLS_HEAP_SIZE=60000

# --- Distributable artifact: emit zephyr.hex (addresses embedded) -----------
CONFIG_BUILD_OUTPUT_HEX=y
```

## boards/same54_xpro.conf
```kconfig
# SAM E54 Xplained Pro board config for the quickstart demo -- ETHERNET bearer.
#
# The SAME54's GMAC is wired (RMII) to an onboard Microchip KSZ8091 PHY + RJ45,
# and the board devicetree already enables gmac/mdio/phy with the factory MAC
# address read from the onboard AT24MAC402 EEPROM (nvmem cell) -- so no overlay
# is needed. This .conf only turns on L2 + DHCPv4 so the interface
# self-configures and the SDK's connection manager sees L4 up.
#
# NOTE: this targets the legacy Atmel-tree board (`same54_xpro`), which has
# working Ethernet in Zephyr v4.4.1. Microchip's new-tree port of the same
# hardware (`sam_e54_xpro`) has no GMAC node yet; migrate when it lands.

# --- Bearer: native Ethernet (GMAC + KSZ8091 RMII) --------------------------
CONFIG_NET_L2_ETHERNET=y
CONFIG_ETH_SAM_GMAC=y
CONFIG_MDIO=y

# --- IPv4 via DHCP; auto-bring-up the interface ----------------------------
CONFIG_NET_DHCPV4=y
CONFIG_NET_CONFIG_AUTO_INIT=y
CONFIG_NET_CONFIG_NEED_IPV4=y
CONFIG_NET_CONFIG_SETTINGS=y

# --- Net buffers sized for a wired link ------------------------------------
CONFIG_NET_PKT_RX_COUNT=16
CONFIG_NET_PKT_TX_COUNT=16
CONFIG_NET_BUF_RX_COUNT=32
CONFIG_NET_BUF_TX_COUNT=32
CONFIG_NET_CONTEXT_RCVTIMEO=y

# --- mbedTLS heap headroom for cloud broker cert chains --------------------
CONFIG_MBEDTLS_HEAP_SIZE=60000

# --- Software-crypto speed (no HW accel on SAME54) --------------------------
# Without the NIST-curve optimization, the ECDHE/ECDSA TLS handshake on this
# 120 MHz M4F overruns AWS IoT's ~10 s handshake window and mqtt_connect
# fails with -116 (hardware-observed). ROM AES tables trade flash for setup time.
CONFIG_MBEDTLS_ECP_NIST_OPTIM=y
CONFIG_MBEDTLS_AES_ROM_TABLES=y

# --- Distributable artifact: emit zephyr.hex (addresses embedded) -----------
CONFIG_BUILD_OUTPUT_HEX=y
```

## boards/frdm_imx93_mimx9352_a55.overlay
```dts
/*
 * FRDM-IMX93 Cortex-A55 quickstart overlay.
 *   - Extend the Zephyr DRAM window (the 1 MB board default is too small for
 *     arm64 + net + TLS + keygen). Must fit the DDR region your Linux/U-Boot
 *     reserves for the M33/Zephyr companion -- adjust per BSP.
 *   - Enable usdhc1 (the on-SOM eMMC, disk "SD2") for the provisioned-identity
 *     store. The board doc recommends using uSDHC1 for Zephyr storage when the
 *     ROM boots from the uSDHC2 SD card slot -- using the boot controller
 *     (uSDHC2) from Zephyr stalls on the first data-line transfer. The eMMC is
 *     a separate controller the boot ROM does not touch.
 */

&dram {
	reg = <0xd0000000 DT_SIZE_M(16)>;
};

&usdhc1 {
	status = "okay";

	sdmmc {
		status = "okay";
	};
};
```

## src/main.c
```c
/*
 * Copyright (c) 2026 Avnet, Inc.
 * SPDX-License-Identifier: MIT
 *
 * IOTCONNECT Zephyr quickstart.
 *
 * A ready-to-flash binary: no build toolchain, no credentials baked in. Flash
 * the .hex, open the serial console, and provision the device to your own
 * IOTCONNECT account entirely from the prompt:
 *
 *   1. iotcprov provision <duid>      -- device generates its OWN key + cert
 *   2. Register the printed cert in IOTCONNECT (Create Device, Self-Signed)
 *   3. iotc config  + paste iotcDeviceConfig.json   -- sets cpid/env/duid
 *   4. kernel reboot cold             -- connects as your device
 *
 * Only the public CA roots are compiled in (quickstart_credentials.h); the
 * per-device key is generated on-chip and stored in NVS.
 */

#include <stdbool.h>
#include <stdio.h>

#include <zephyr/kernel.h>
#include <zephyr/logging/log.h>
#include <zephyr/random/random.h>
#include <zephyr/net/net_if.h>
#include <zephyr/net/net_mgmt.h>
#include <zephyr/net/net_event.h>
#include <zephyr/net/conn_mgr_monitor.h>

#include "iotconnect.h"
#include "iotcl.h"
#include "iotcl_telemetry.h"
#include "iotconnect_identity.h"
#include "iotc_time.h"
#include "quickstart_credentials.h"

LOG_MODULE_REGISTER(quickstart, LOG_LEVEL_INF);

static void print_guide(const char *reason)
{
	printk("\n");
	printk("========================================================\n");
	printk("  IOTCONNECT QUICKSTART -- device is not provisioned\n");
	printk("  (%s)\n", reason);
	printk("--------------------------------------------------------\n");
	printk("  1) Generate this device's identity ON the device:\n");
	printk("        iotcprov provision <your-duid>\n");
	printk("  2) In IOTCONNECT: Create Device (Self-Signed) and paste\n");
	printk("     the certificate it printed.\n");
	printk("  3) Paste the downloaded iotcDeviceConfig.json:\n");
	printk("        iotc config\n");
	printk("        { ...paste the json block... }\n");
	printk("  4) Connect:  kernel reboot cold\n");
	printk("========================================================\n\n");
}

/* --- Network bring-up ----------------------------------------------------- */
static K_SEM_DEFINE(l4_connected_sem, 0, 1);
static struct net_mgmt_event_callback l4_cb;
#define L4_EVENT_MASK (NET_EVENT_L4_CONNECTED | NET_EVENT_L4_DISCONNECTED)

static void l4_event_handler(struct net_mgmt_event_callback *cb,
			     uint64_t mgmt_event, struct net_if *iface)
{
	ARG_UNUSED(cb);
	ARG_UNUSED(iface);
	if (mgmt_event == NET_EVENT_L4_CONNECTED) {
		k_sem_give(&l4_connected_sem);
	}
}

static int network_up(void)
{
	struct net_if *iface = net_if_get_default();

	if (iface == NULL) {
		return -ENODEV;
	}
	net_mgmt_init_event_callback(&l4_cb, l4_event_handler, L4_EVENT_MASK);
	net_mgmt_add_event_callback(&l4_cb);
	if (!net_if_is_up(iface)) {
		int ret = net_if_up(iface);

		if (ret && ret != -EALREADY) {
			return ret;
		}
	}
	conn_mgr_mon_resend_status();
	LOG_INF("Waiting for network connectivity...");
	k_sem_take(&l4_connected_sem, K_FOREVER);
	return 0;
}

int main(void)
{
	struct iotc_identity id;
	int ret;

	printk("\nIOTCONNECT Zephyr quickstart\n");

	/* Device identity comes entirely from NVS (provisioned at the prompt). */
	if (iotc_identity_load(&id) != 0) {
		print_guide("no identity stored in NVS");
		return 0; /* stay alive at the shell for provisioning */
	}
	LOG_INF("Provisioned as duid=%s -- bringing up network", id.duid);

	if (network_up() != 0) {
		LOG_ERR("network did not come up");
		return 0;
	}
	ret = iotc_time_sync(CONFIG_IOTCONNECT_SNTP_SERVER, CONFIG_IOTCONNECT_SNTP_TIMEOUT_MS);
	if (ret) {
		LOG_ERR("SNTP sync failed (%d)", ret);
		return 0;
	}

	IotConnectClientConfig config;

	iotconnect_sdk_init_config(&config);
	config.connection_type = IOTC_CT_AWS;
	config.cpid = (char *)id.cpid;
	config.env = (char *)id.env;
	config.duid = (char *)id.duid;
	config.auth_info.type = IOTC_AT_X509;
	config.auth_info.ca_cert = broker_ca_pem;         /* public roots, compiled in */
	config.auth_info.ca_cert_len = sizeof(broker_ca_pem);
	config.auth_info.dra_ca = dra_ca_pem;
	config.auth_info.dra_ca_len = sizeof(dra_ca_pem);
	config.auth_info.data.cert_info.device_cert = id.device_cert;     /* from NVS */
	config.auth_info.data.cert_info.device_cert_len = id.device_cert_len;
	config.auth_info.data.cert_info.device_key = id.device_key;       /* from NVS */
	config.auth_info.data.cert_info.device_key_len = id.device_key_len;
	config.verbose = true;

	ret = iotconnect_sdk_init(&config);
	if (ret) {
		LOG_ERR("iotconnect_sdk_init failed (%d)", ret);
		return 0;
	}

	while (true) {
		if (iotconnect_sdk_connect() != 0) {
			k_sleep(K_SECONDS(5));
			continue;
		}
		while (iotconnect_sdk_is_connected()) {
			IotclMessageHandle msg = iotcl_telemetry_create();

			if (msg != NULL) {
				iotcl_telemetry_set_number(msg, "random",
							   (double)(sys_rand32_get() % 100));
				iotcl_telemetry_set_string(msg, "version", "1.0.0");
				(void)iotcl_mqtt_send_telemetry(msg, false);
				iotcl_telemetry_destroy(msg);
			}
			k_sleep(K_SECONDS(10));
		}
		iotconnect_sdk_disconnect();
		LOG_WRN("Disconnected; reconnecting...");
	}
	return 0;
}
```
